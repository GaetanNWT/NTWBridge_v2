VERSION ""

NS_ :

BS_:

BU_:

BO_ 3221225472 VECTOR__INDEPENDENT_SIG_MSG: 0 Vector__XXX
 SG_ NewSignal_0003 : 16|8@1+ (1,0) [0|0] "" Vector__XXX

BO_ 1 Data: 8 Vector__XXX
 SG_ Temperature : 7|16@0+ (0.5,-40) [0|0] "" Vector__XXX
 SG_ SOC : 23|16@0+ (0.01,0) [0|0] "" Vector__XXX
